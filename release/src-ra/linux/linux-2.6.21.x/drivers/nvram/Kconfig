## release/src-ra/linux/linux-2.6.21.x/drivers/nvram/Kconfig
```kconfig
menu "ASUS NVRAM"

config	ASUS_NVRAM_API
	tristate "ASUS NVRAM R/W API"
	default m
	---help---
	ASUS NVRAM R/W API

endmenu
```

## release/src-ra/linux/linux-2.6.21.x/ralink/Kconfig
```kconfig
menu "Ralink Module"

config  ASUS_SW_QOS
	bool "ASUS SW QoS"
	default y

###########
# Debuging
###########
source "drivers/net/rt_rdm/Kconfig"

#############
# Wire
#############
source "drivers/net/raeth/Kconfig"

#############
# Wireless
#############

config  RT2860V2_2850
        bool "Dual Band"
        depends on RALINK_RT2880

choice
        prompt "RF Type"
        depends on RALINK_RT3052 || RALINK_RT3352
        default RALINK_RT3052_2T2R

        config  RALINK_RT3050_1T1R
        bool "1T1R"

        config  RALINK_RT3051_1T2R
        bool "1T2R"

        config  RALINK_RT3052_2T2R
        bool "2T2R"
endchoice

choice
	prompt "RF Type"
	depends on RALINK_RT3883

	config  RALINK_RT3662_2T2R
	bool "2T3R (RT3662)"

	config  RALINK_RT3883_3T3R
	bool "3T3R (RT3883)"
endchoice

source "drivers/net/wireless/rt2860v2_ap/Kconfig"
source "drivers/net/wireless/rt2860v2_sta/Kconfig"
#source "drivers/net/wireless/rt2860v2_apsta/Kconfig"
source "drivers/net/wireless/RT3090_ap/Kconfig"
#source "drivers/net/wireless/RT3572_ap/Kconfig"
#source "drivers/net/wireless/iNIC/Kconfig"
#source "drivers/net/wireless/iNIC_RT305x/Kconfig"

config RTDEV_USB
bool
default y if RT305x_INIC_USB || RT3572_AP

config RTDEV_MII
bool
default y if RT2880v2_INIC_MII || RT305x_INIC_MII

config RTDEV_PCI
bool
default y if RT2880v2_INIC_PCI || RT3090_AP

#######
# USB
#######
source "drivers/usb/dwc_otg/Kconfig"

config RT3XXX_EHCI_OHCI
	bool "Ralink USB EHCI/OHCI controller support"
        depends on (RALINK_RT3883 || RALINK_RT3352)
	select USB_ARCH_HAS_OHCI
	select USB_ARCH_HAS_EHCI

#######
# NAT
#######
choice
prompt "Ralink NAT Type"
	
config  RA_NAT_NONE
bool "None"
config  RA_NAT_HW
bool "Hardware"
endchoice

source "net/nat/hw_nat/Kconfig"


endmenu
```
